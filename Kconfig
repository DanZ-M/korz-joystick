## Kconfig
```kconfig
config KORZ_JOYSTICK
	bool "Analog joystick as pointing device (korz,joystick)"
	default y
	depends on DT_HAS_KORZ_JOYSTICK_ENABLED
	select ADC
	select INPUT
	select GPIO
	help
	  Reads two ADC channels and the push button and reports them as mouse movement
	  (or scrolling) and left click through ZMK's input listener.

if KORZ_JOYSTICK

choice KORZ_JOY_MODE
	prompt "What the stick does"
	default KORZ_JOY_MODE_MOUSE

config KORZ_JOY_MODE_MOUSE
	bool "Mouse pointer"

config KORZ_JOY_MODE_SCROLL
	bool "Scroll wheel (vertical and horizontal)"

endchoice

config KORZ_JOY_SPEED
	int "Speed at full deflection (pixels per second, or wheel steps per second)"
	default 900 if KORZ_JOY_MODE_MOUSE
	default 12

config KORZ_JOY_DEADZONE
	int "Dead zone around the centre (percent of the stick travel)"
	default 12
	range 0 60

config KORZ_JOY_RANGE
	int "ADC counts from the centre position to the end of the travel"
	default 1600
	range 200 2000
	help
	  12 bit readings on a 3.3 V supply: the centre is about 1870 and the ends about 0 and
	  3750, so about 1600 counts either way leaves a little margin. Turn on
	  KORZ_JOY_DEBUG to see the real values.

config KORZ_JOY_POLL_MS
	int "Sampling period (ms)"
	default 10
	range 5 50

config KORZ_JOY_DEBUG
	bool "Log the raw readings twice a second (needs ZMK_USB_LOGGING)"

endif # KORZ_JOYSTICK
```
